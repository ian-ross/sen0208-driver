/dts-v1/;
/plugin/;

#include <dt-bindings/gpio/gpio.h>

/ {
  compatible = "brcm,bcm2835";

  fragment@0 {
    target-path = "/";
    __overlay__ {
      sen0208: sen0208 {
        compatible = "dfrobot,sen0208";
        status = "okay";
        trig-gpios = <&gpio 27 GPIO_ACTIVE_HIGH>;
        echo-gpios = <&gpio 17 GPIO_ACTIVE_HIGH>;
      };
    };
  };
};
